## libraries/boot-protocol/zephyr/Kconfig
```kconfig
menuconfig MULTI_MCU_BOOT_PROTOCOL
    bool "Multi-MCU portable boot protocol"
    default y
```

## libraries/diagnostics/zephyr/Kconfig
```kconfig
menuconfig MULTI_MCU_DIAGNOSTICS
    bool "Multi-MCU portable diagnostics"
    default y
```

## libraries/firmware-image/zephyr/Kconfig
```kconfig
menuconfig MULTI_MCU_FIRMWARE_IMAGE
    bool "Multi-MCU portable firmware image parser"
    default y
```

## libraries/node-api/zephyr/Kconfig
```kconfig
menuconfig MULTI_MCU_NODE_API
    bool "Multi-MCU portable node API"
    default y
```

## libraries/protocol/zephyr/Kconfig
```kconfig
menuconfig MULTI_MCU_PROTOCOL
    bool "Multi-MCU portable protocol primitives"
    default y
```

## west.yml
```yaml
manifest:
  version: "1.2"
  projects:
    - name: nrf
      url: https://github.com/nrfconnect/sdk-nrf
      revision: v3.4.1
      import: true
  self:
    path: multi-mcu-system
```
